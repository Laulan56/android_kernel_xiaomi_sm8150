## Documentation/devicetree/bindings/nfc/max32560.txt
```
Maxim max32560 NFC NCI device

Near Field Communication (NFC) device is based on NFC Controller Interface (NCI)

Required properties:

- compatible: "maxim,max32560"
- reg: NCI spi slave address.
- maxim,irq-gpio: specific gpio for read interrupt.
- maxim,reset-gpio: specific gpio for hardware reset.
- maxim,en-gpio: gpio for enabling nfc
- interrupt-parent: Should be phandle for the interrupt controller
                    that services interrupts for this device.
- interrupts: Nfc read interrupt

Example:

&qupv3_se0_spi {
	status = "ok";

	max32560@0 {
		compatible = "maxim,max32560";
		reg = <0>;
		spi-max-frequency = <2000000>;

		maxim,irq-gpio = <&tlmm 85 0x00>;
		maxim,en-gpio = <&tlmm 84 0x00>;
		maxim,reset-gpio = <&tlmm 83 0x00>;

		interrupt-parent = <&tlmm>;
		interrupts = <85 0>;
       };
};
```

## drivers/nfc/max32560/Kconfig
```kconfig
#
# MAX32560 NFC driver configuration
#
config NFC_MAX32560
	tristate "MAX32560 NFC SPI driver"
	help
	  This module adds support for the MAX32560 NFC controller
	  spi interface.

	  If unsure, say N.
```

## techpack/data/drivers/Kconfig
```kconfig
menu "Qualcomm RmNet extensions"

#source "techpack/data/drivers/emac-dwc-eqos/Kconfig_app"

#source "techpack/data/drivers/generic-sw-bridge/Kconfig"

source "techpack/data/drivers/rmnet/Kconfig"

endmenu
```
